## main/Kconfig.projbuild
```kconfig
menu "WebCam Configuration"

    config WIFI_SSID
        string "WiFi SSID"
        default "myssid"
        help
            SSID (network name) for the example to connect to.

    config WIFI_PASSWORD
        string "WiFi Password"
        default "mypassword"
        help
            WiFi password (WPA or WPA2) for the example to use.

            Can be left blank if the network has no security set.

    config SERVER_URI
        string "Server URI"
        default "https://uri"
        help
            Server host URI.

    config SERVER_NAME
        string "Server user name"
        default "user name"
        help
            The name of user for authorization

    config SERVER_PASS
        string "Server user password"
        default "user password"
        help
            The password for authorization
            
    config WC_DEVICE_NAME
        string "BLE device service config"
        default "babaikaWCCamv1"
        help
            The value of BLE UUID for service                   
            
    config WC_DEVICE_SERVICE_UUID
        hex "BLE device service config"
        default 0x9ef0
        help
            The value of BLE UUID for service            
            
    config WC_DEVICE_CHAR1_UUID
        hex "BLE device char 1 config"
        default 0x9ef1
        help
            The value of BLE UUID for char 1 (write char)
            
    config WC_DEVICE_CHAR2_UUID
        hex "BLE device char 2 config"
        default 0x9ef2
        help
            The value of BLE UUID for char 2 (read char)           

endmenu
menu "Buttons Configuration"

    choice BUTTON_TIMER_IMPLEMENT
        bool "Button Timer Mode"
        default BUTTON_USE_ESP_TIMER
        help
            Choose a implementation of timer for button instance.

        config BUTTON_USE_RTOS_TIMER
            bool "Use FreeRTOS Timer"

        config BUTTON_USE_ESP_TIMER
            bool "Use ESP Timer"
    endchoice

    config BUTTON_IO_GLITCH_FILTER_TIME_MS
        int "IO glitch filter timer ms (10~100)"
        range 10 100
        default 50

endmenu
menu "Camera driver configuration"

    config OV7670_SUPPORT
        bool "Support OV7670 VGA"
        default y
        help
            Enable this option if you want to use the OV7670.
            Disable this option to save memory.

    config OV7725_SUPPORT
        bool "Support OV7725 VGA"
        default y
        help
            Enable this option if you want to use the OV7725.
            Disable this option to save memory.

    config NT99141_SUPPORT
        bool "Support NT99141 HD"
        default y
        help
            Enable this option if you want to use the NT99141.
            Disable this option to save memory.

    config OV2640_SUPPORT
        bool "Support OV2640 2MP"
        default y
        help
            Enable this option if you want to use the OV2640.
            Disable this option to save memory.

    config OV3660_SUPPORT
        bool "Support OV3660 3MP"
        default y
        help
            Enable this option if you want to use the OV3360.
            Disable this option to save memory.

    config OV5640_SUPPORT
        bool "Support OV5640 5MP"
        default y
        help
            Enable this option if you want to use the OV5640.
            Disable this option to save memory.

    config GC2145_SUPPORT
        bool "Support GC2145 2MP"
        default y
        help
            Enable this option if you want to use the GC2145.
            Disable this option to save memory.

    config GC032A_SUPPORT
        bool "Support GC032A VGA"
        default y
        help
            Enable this option if you want to use the GC032A.
            Disable this option to save memory.

    config GC0308_SUPPORT
        bool "Support GC0308 VGA"
        default y
        help
            Enable this option if you want to use the GC0308.
            Disable this option to save memory.
            
    config BF3005_SUPPORT
        bool "Support BF3005(BYD3005) VGA"
        default y
        help
            Enable this option if you want to use the BF3005.
            Disable this option to save memory.

    choice SCCB_HARDWARE_I2C_PORT
        bool "I2C peripheral to use for SCCB"
        default SCCB_HARDWARE_I2C_PORT1

        config SCCB_HARDWARE_I2C_PORT0
            bool "I2C0"
        config SCCB_HARDWARE_I2C_PORT1
            bool "I2C1"

    endchoice

    config SCCB_CLK_FREQ
    int "SCCB clk frequency"
    default 100000
    range 100000 400000
    help
        Increasing this value can reduce the initialization time of the sensor.
        Please refer to the relevant instructions of the sensor to adjust the value.
    
    choice GC_SENSOR_WINDOW_MODE
        bool "GalaxyCore Sensor Window Mode"
        depends on (GC2145_SUPPORT || GC032A_SUPPORT || GC0308_SUPPORT)
        default GC_SENSOR_SUBSAMPLE_MODE
        help
            This option determines how to reduce the output size when the resolution you set is less than the maximum resolution.
            SUBSAMPLE_MODE has a bigger perspective and WINDOWING_MODE has a higher frame rate.

        config GC_SENSOR_WINDOWING_MODE
            bool "Windowing Mode"
        config GC_SENSOR_SUBSAMPLE_MODE
            bool "Subsample Mode"
    endchoice

    choice CAMERA_TASK_PINNED_TO_CORE
        bool "Camera task pinned to core"
        default CAMERA_CORE0
        help
            Pin the camera handle task to a certain core(0/1). It can also be done automatically choosing NO_AFFINITY.

        config CAMERA_CORE0
            bool "CORE0"
        config CAMERA_CORE1
            bool "CORE1"
        config CAMERA_NO_AFFINITY
            bool "NO_AFFINITY"

    endchoice

    config CAMERA_DMA_BUFFER_SIZE_MAX
        int "DMA buffer size"
        range 8192 32768
        default 32768
        help
            Maximum value of DMA buffer
            Larger values may fail to allocate due to insufficient contiguous memory blocks, and smaller value may cause DMA interrupt to be too frequent

endmenu


menu "WC and H2PC configuration"

    config WC_USE_IO_STREAMS
        bool "Use IO streams"
        default n
        help
            Disable of enable io frame streaming for WCClient
            
    config H2PC_MAX_ALLOWED_FRAMES
        int "Max allowed number of incoming frames"        
        default 32
        help
            Maximum size of the incoming frames pool. If exceeds - new frames are ignored            
            
    config H2PC_MAX_ALLOWED_FRAMES_SIZE
        hex "Max allowed total size of incoming frames in bytes"
        default 0x100000
        help
            Maximum size in bytes of the incoming frames pool. If exceeds - new frames are ignored

    config H2PC_INITIAL_RESP_BUFFER
        hex "Initial resp buffer"
        default 0x8000
        help
            Defines the initial size in bytes of the response buffer
            
    config H2PC_MAXIMUM_RESP_BUFFER
        hex "Maximum resp buffer"
        default 0x200000
        help
            Defines the maximum size in bytes of the response buffer
                   
            
endmenu
```
